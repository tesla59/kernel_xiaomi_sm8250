## drivers/airoha/Kconfig
```kconfig
config AIROHA_GPS
	bool "Airoha GPS Support"
	default n
	help
	  Airoha GPS Support
```

## drivers/gpu/drm/xiaomi/Kconfig
```kconfig
config DRM_XIAOMI
	tristate "Xiaomi DRM extension"
	depends on DRM
	default y if MACH_XIAOMI
	help
	   Xiaomi DRM extensions
```

## drivers/input/fingerprint/Kconfig
```kconfig
#
# Fingerprint driver configuration
#

source "drivers/input/fingerprint/fpc/Kconfig"
source "drivers/input/fingerprint/fpc_fod/Kconfig"
source "drivers/input/fingerprint/goodix/Kconfig"
source "drivers/input/fingerprint/goodix_fod/Kconfig"
source "drivers/input/fingerprint/goodix_fod_psy/Kconfig"
```

## drivers/input/fingerprint/fpc/Kconfig
```kconfig
config FINGERPRINT_FPC
	tristate "Finger print card fpc"
	help
	  Say Y here to enable support for retrieving self-test reports.

	  If unsure, say N.

	  To compile this driver as a module, choose M here.
```

## drivers/input/fingerprint/goodix/Kconfig
```kconfig
config GOODIX_NETLINK
    tristate "Goodix netlink"
    help
      Select Y here to enable Goodix netlink library.

source "drivers/input/fingerprint/goodix/goodix/Kconfig"
source "drivers/input/fingerprint/goodix/goodix_fod/Kconfig"
```

## drivers/input/fingerprint/goodix/goodix_fod/Kconfig
```kconfig
config FINGERPRINT_GOODIX_FOD
	tristate "Finger print card goodix"
	depends on INPUT_FINGERPRINT
	select GOODIX_NETLINK
	help
	  Say Y here to enable support for retrieving self-test reports.

	  If unsure, say N.

	  To compile this driver as a module, choose M here.
```

## drivers/input/touchscreen/xiaomi/Kconfig
```kconfig
if MACH_XIAOMI

menuconfig TOUCHSCREEN_XIAOMI
    bool "Xiaomi Touchscreens"
    default y if MACH_XIAOMI
    help
      Touchscreen drivers for Xiaomi devices.

if TOUCHSCREEN_XIAOMI

source "drivers/input/touchscreen/xiaomi/focaltech_spi/Kconfig"

source "drivers/input/touchscreen/xiaomi/focaltech_touch_mi/Kconfig"

source "drivers/input/touchscreen/xiaomi/focaltouch/Kconfig"

source "drivers/input/touchscreen/xiaomi/fts_521/Kconfig"

source "drivers/input/touchscreen/xiaomi/goodix_driver_gt9886/Kconfig"

source "drivers/input/touchscreen/xiaomi/nt36523/Kconfig"

source "drivers/input/touchscreen/xiaomi/nt36672c/Kconfig"

source "drivers/input/touchscreen/xiaomi/xiaomi_touch/Kconfig"

endif

endif
```

## drivers/power/supply/xiaomi/Kconfig
```kconfig
if MACH_XIAOMI

menu "Xiaomi charging drivers"

source "drivers/power/supply/xiaomi/cas_qcom/Kconfig"
source "drivers/power/supply/xiaomi/idt/Kconfig"
source "drivers/power/supply/xiaomi/lionsemi/Kconfig"
source "drivers/power/supply/xiaomi/maxim/Kconfig"
source "drivers/power/supply/xiaomi/nuvolta/Kconfig"
source "drivers/power/supply/xiaomi/ti/Kconfig"

endmenu

endif
```

## drivers/power/supply/xiaomi/idt/Kconfig
```kconfig
menu "Integrated Device Technology charger support"

source "drivers/power/supply/xiaomi/idt/idtp9415/Kconfig"

source "drivers/power/supply/xiaomi/idt/idtp9415_cas/Kconfig"

source "drivers/power/supply/xiaomi/idt/idtp9418/Kconfig"

endmenu
```

## drivers/power/supply/xiaomi/idt/idtp9415/Kconfig
```kconfig
config IDT_P9415
	tristate "idtp9415 wireless Charger"
	depends on I2C
	help
	  Say Y to include support for idtp9415 wireless Charger.
	  idtp9415 is a wireless battery charger.
	  The driver supports charger enable/disable.
	  The driver reports the charger status via the power supply framework.
	  The driver controls idtp9415 via I2C and
	  supports device-tree interface.
```

## drivers/power/supply/xiaomi/idt/idtp9418/Kconfig
```kconfig
config IDT_P9418
	tristate "idtp9418 wireless Charger"
	depends on I2C
	help
	  Say Y to include support for idtp9418 wireless Charger.
	  idtp9418 is a wireless battery charger.
	  The driver supports charger enable/disable.
	  The driver reports the charger status via the power supply framework.
	  The driver controls idtp9418 via I2C and
	  supports device-tree interface.
```

## drivers/power/supply/xiaomi/lionsemi/Kconfig
```kconfig
menu "Lion Semiconductor charger support"

source "drivers/power/supply/xiaomi/lionsemi/ln8282/Kconfig"

endmenu
```

## drivers/power/supply/xiaomi/maxim/Kconfig
```kconfig
menu "Maxim Integrated Products charger support"

config ONEWIRE_GPIO
	bool
	prompt "Support Onewire Driver."
	default n
	help
		It's an onewire driver.

source "drivers/power/supply/xiaomi/maxim/ds28e16/Kconfig"

source "drivers/power/supply/xiaomi/maxim/max28200/Kconfig"

source "drivers/power/supply/xiaomi/maxim/max77932/Kconfig"

endmenu
```

## drivers/power/supply/xiaomi/maxim/ds28e16/Kconfig
```kconfig
config BATT_VERIFY_BY_DS28E16
	bool
	prompt "Support ds28e16 as encryption IC."
	default n
    select ONEWIRE_GPIO
	help
		It needs a onewire physical controller to work.
```

## drivers/power/supply/xiaomi/maxim/max28200/Kconfig
```kconfig
config WATCHDOG_MAX28200
	tristate "maxim watch dog max28200 driver"
	help
	  Say Y to enable support for maxim max28200 driver
```

## drivers/power/supply/xiaomi/maxim/max77932/Kconfig
```kconfig
config CP_MAX77932
	tristate "maxim charger pump max77932 driver"
	help
	  Say Y to enable support for charger pump driver
```

## drivers/power/supply/xiaomi/nuvolta/Kconfig
```kconfig
menu "NuVolta charger support"

source "drivers/power/supply/xiaomi/nuvolta/rx1619/Kconfig"

source "drivers/power/supply/xiaomi/nuvolta/rx1619_cas/Kconfig"

endmenu
```

## drivers/power/supply/xiaomi/nuvolta/rx1619/Kconfig
```kconfig
config RX1619
	tristate "RX1619 wireless Charger"
	depends on I2C
	help
	  Say Y to include support for rx1619 wireless Charger.
	  RX1619 is a wireless battery charger chip.
	  The driver supports charger enable/disable.
	  The driver reports the charger status via the power supply framework.
	  The driver controls rx1619 via I2C and
	  supports device-tree interface.

config RX1619_TRIM
	tristate "RX1619 TRIM"
	depends on I2C
	help
	  Say Y to include support for rx1619 wireless Charger.
	  RX1619 is a wireless battery charger chip.
	  The driver supports charger enable/disable.
	  The driver reports the charger status via the power supply framework.
	  The driver controls rx1619 via I2C and
	  supports device-tree interface.
```

## drivers/power/supply/xiaomi/nuvolta/rx1619_cas/Kconfig
```kconfig
config RX1619_CAS
	tristate "RX1619 wireless Charger"
	depends on I2C
	help
	  Say Y to include support for rx1619 wireless Charger.
	  RX1619 is a wireless battery charger chip.
	  The driver supports charger enable/disable.
	  The driver reports the charger status via the power supply framework.
	  The driver controls rx1619 via I2C and
	  supports device-tree interface.

config RX1619_TRIM_CAS
	tristate "RX1619 TRIM"
	depends on I2C
	help
	  Say Y to include support for rx1619 wireless Charger.
	  RX1619 is a wireless battery charger chip.
	  The driver supports charger enable/disable.
	  The driver reports the charger status via the power supply framework.
	  The driver controls rx1619 via I2C and
	  supports device-tree interface.
```

## drivers/power/supply/xiaomi/ti/Kconfig
```kconfig
menu "TI Technologies, Inc. charger support"

config CP_QC30
	tristate "CP quick charge 3.0"
	depends on I2C
	help
	  Say Y to include support for CP quick charge 3.0.

config PD_POLICY_MANAGER
	tristate "PD policy manager driver"
	depends on I2C
	help
	  Say Y to include support for PD policy manager.

source "drivers/power/supply/xiaomi/ti/bq_wireless/Kconfig"

source "drivers/power/supply/xiaomi/ti/bq2597x/Kconfig"

source "drivers/power/supply/xiaomi/ti/bq25790/Kconfig"

source "drivers/power/supply/xiaomi/ti/ln8000/Kconfig"

endmenu
```

## drivers/power/supply/xiaomi/ti/bq25790/Kconfig
```kconfig
config CHARGER_BQ25790
	tristate "TI BQ25790 battery charger driver"
	depends on I2C
	help
	  Say Y to enable support for TI bq2588x charger driver
```

## drivers/power/supply/xiaomi/ti/bq2597x/Kconfig
```kconfig
config BQ2597X_CHARGE_PUMP
	tristate "BQ2597X power supply framework based driver"
	depends on I2C
	select CP_QC30
	select PD_POLICY_MANAGER
	help
	  Say Y to include support for BQ2597X Charge Pump driver based on
	  power supply framework.
	  BQ2597X is a div2 charge pump capable of delivering 8A charge current
	  with very high efficiency.

config DUAL_BQ2597X
	tristate "BQ2597X power supply framework based driver"
	depends on BQ2597X_CHARGE_PUMP
	help
	 Say Y to include support for dual BQ2597X Charge Pump driver based on
	 power supply framework.
```

## drivers/power/supply/xiaomi/ti/bq_wireless/Kconfig
```kconfig
config BQ_PUMP_WIRELESS_CHARGE
	tristate "BQ2597X wireless dc charge policy driver"
	depends on I2C
	help
	  Say Y to include support for BQ2597X Charge Pump Wireless Charging
	  based on power supply framework.
```

## drivers/power/supply/xiaomi/ti/ln8000/Kconfig
```kconfig
config CHARGER_LN8000
	tristate "LionSemi LN8000 Battery Charger"
	depends on I2C
	select REGMAP_I2C
	select CP_QC30
	select PD_POLICY_MANAGER
	help
	  Say Y to enable support for the LN8000 charger
```

## techpack/audio/asoc/codecs/Kconfig
```kconfig
menu "Qualcomm ASoC additional codecs"

config SND_SOC_CS35L41
    tristate
    depends on MACH_XIAOMI
    default y

config SND_SOC_CS35L41_V2
    tristate
    depends on MACH_XIAOMI
    default y

config SND_SOC_TFA9874
    tristate
    depends on MACH_XIAOMI
    default y

endmenu
```
